## Kconfig.sbr
```kconfig
menu "Self Balancing Robot"

rsource "subsys/Kconfig"
# rsource "samples/Kconfig"
rsource "lib/Kconfig"

endmenu
```

## samples/app_event_manager/src/events/Kconfig
```kconfig
#
# Copyright (c) 2020 Nordic Semiconductor
#
# SPDX-License-Identifier: LicenseRef-Nordic-5-Clause
#

if LOG

menu "Event options"

comment "Initially logged events"

config BRIDGE_LOG_MODULE_STATE_EVENT
	bool "Module state event"
	default y


endmenu

endif
```

## samples/app_event_manager/src/modules/Kconfig.common
```kconfig
#
# Copyright (c) 2020 Nordic Semiconductor
#
# SPDX-License-Identifier: LicenseRef-Nordic-5-Clause
#


config CONFIG_MQTT
	bool "Enable USB CDC ACM"
	depends on USB_DEVICE_STACK
	select USB_CDC_ACM
	help
		This option enables USB CDC ACM
		and exposes two COM ports, bridging the two UART interfaces.

if BRIDGE_CDC_ENABLE

module = BRIDGE_CDC
module-str = USB CDC ACM device
source "subsys/logging/Kconfig.template.log_config"

endif
```

## samples/aws_ble_mesh_gateway/src/modules/Kconfig.cloud_module
```kconfig
#
# Copyright (c) 2021 Nordic Semiconductor
#
# SPDX-License-Identifier: LicenseRef-Nordic-5-Clause
#

menu "Cloud module"

config CLOUD_THREAD_STACK_SIZE
	int "Modem module thread stack size"
	default 2048

config CLOUD_CONNECT_RETRIES
	int "Cloud reconnection attempts"
	default 10
	help
	  If the cloud module exceeds the number of reconnection attempts it will
	  send out an error event.
	  
endmenu
```

## samples/aws_ble_mesh_gateway/src/modules/Kconfig.mesh_module
```kconfig
menu "Mesh module"

config MESH_MODULE_THREAD_STACK_SIZE 
    int "Thread stack size"
    default "2048"

module = MESH_MODULE
module-str = Mesh module
source "subsys/logging/Kconfig.template.log_config"

endmenu
```

## samples/aws_ble_mesh_gateway/src/modules/Kconfig.modem_module
```kconfig
#
# Copyright (c) 2021 Nordic Semiconductor
#
# SPDX-License-Identifier: LicenseRef-Nordic-5-Clause
#

menu "Modem module"

config MODEM_THREAD_STACK_SIZE
	int "Modem module thread stack size"
	default 2048

endmenu
```

## samples/aws_ble_mesh_gateway/src/modules/Kconfig.robot_module
```kconfig
#
# Copyright (c) 2021 Nordic Semiconductor
#
# SPDX-License-Identifier: LicenseRef-Nordic-5-Clause
#

menu "Robot module"

config ROBOT_THREAD_STACK_SIZE
	int "Robot module thread stack size"
	default 2048

endmenu
```

## samples/mesh_bot/drivers/tb6612fng/Kconfig
```kconfig
menu "TB6612FNG driver"
config TB6612FNG
    bool "Enable TB6612FNG dual brushed DC motor driver"
    depends on PWM && GPIO

if TB6612FNG
    module = TB6612FNG_DRIVER
    module-str = TB6612FNG driver
    source "subsys/logging/Kconfig.template.log_config"

    module = TB6612FNG_MOTOR_DRIVER
    module-str = TB6612FNG motor driver
    source "subsys/logging/Kconfig.template.log_config"
endif
endmenu
```

## samples/mesh_bot/src/events/Kconfig
```kconfig
#
# Copyright (c) 2020 Nordic Semiconductor
#
# SPDX-License-Identifier: LicenseRef-Nordic-5-Clause
#

if LOG

menu "Event options"

comment "Initially logged events"

config BRIDGE_LOG_MODULE_STATE_EVENT
	bool "Module state event"
	default y

config LOG_MESH_MODULE_EVENT
	bool "Mesh module event"
	default n

config LOG_MOTOR_MODULE_EVENT
	bool "Motor module event"
	default n

endmenu

endif
```

## samples/mesh_bot/src/modules/Kconfig.mesh
```kconfig
menuconfig MESH_MODULE
    bool "Mesh module"
    default y
    help
      Enables mesh module.

if MESH_MODULE

    config MESH_THREAD_STACK_SIZE
        int "Stack size for mesh module thread"
        default 2048

    module = MESH_MODULE
    module-str = Mesh module
    source "subsys/logging/Kconfig.template.log_config"

endif
```

## samples/mesh_bot/src/modules/Kconfig.motor
```kconfig
menuconfig MOTOR_MODULE
    bool "Motor module"
    default y
    help
      Enables motor module.

if MOTOR_MODULE

    config MOTOR_THREAD_STACK_SIZE
        int "Stack size for motor module thread"
        default 2048

    module = MOTOR_MODULE
    module-str = Motor module
    source "subsys/logging/Kconfig.template.log_config"

endif
```

## west.yml
```yaml
# The west manifest file for the NCS-MIDI project.
#
# The per-installation west configuration file specifies the location of this
# manifest file. The "path" option in the [manifest] section of .west/config
# defines the folder that contains west.yml. The path is relative to the folder
# that contains .west.
#

manifest:
  version: "0.12"
  remotes:
      # nRF Connect SDK base URL.
    - name: ncs
      url-base: https://github.com/nrfconnect
  # The list of external projects for the nRF Connect SDK.
  #
  projects:
    - name: nrf
      remote: ncs
      repo-path: sdk-nrf
      revision: 69bfabb5a6248d306977d8247084d4b6ddf405ed
      import: true
  # Committed on Oct 15 

# West-related configuration for the nrf_midi_priv repository.
  self:
    path: nrf_self_balancing_robot
```
